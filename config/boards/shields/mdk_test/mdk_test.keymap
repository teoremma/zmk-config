/*
 * Copyright (c) 2020 teoremma
 *
 * SPDX-License-Identifier: MIT
 */

#include <behaviors.dtsi>
#include <dt-bindings/zmk/keys.h>
#include <dt-bindings/zmk/bt.h>
#include <dt-bindings/zmk/outputs.h>

/ {
    keymap {
        compatible = "zmk,keymap";
        
        default_layer {
            label = "Test";
            bindings = <
            &kp A
            >;
        };
    };
};