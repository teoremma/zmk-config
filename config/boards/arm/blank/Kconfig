## config/boards/arm/blank/Kconfig
```kconfig
# Copyright (c) 2021 teoremma
# SPDX-License-Identifier: MIT

config BOARD_ENABLE_DCDC
	bool "Enable DCDC mode"
	select SOC_DCDC_NRF52X
	default y
	depends on BOARD_BLANK
```

## config/boards/arm/blank/Kconfig.board
```kconfig
# Copyright (c) 2021 teoremma
# SPDX-License-Identifier: MIT

config BOARD_BLANK
	bool "blank"
	depends on SOC_NRF52840_QIAA
```

## config/boards/arm/blank/Kconfig.defconfig
```kconfig
# Copyright (c) 2021 teoremma
# SPDX-License-Identifier: MIT

if BOARD_BLANK

config BOARD
	default "blank"

config ZMK_KEYBOARD_NAME
	default "blank"

if USB_DEVICE_STACK

config USB_NRFX
	default y

endif # USB_DEVICE_STACK

config BT_CTLR
	default BT

config ZMK_BLE
	default y

config ZMK_USB
	default y

config ZMK_BATTERY_VOLTAGE_DIVIDER
	default y

endif # BOARD_BLANK
```

## config/boards/shields/byte/Kconfig.defconfig
```kconfig
# Copyright (c) 2020 The ZMK Contributors
# SPDX-License-Identifier: MIT

if SHIELD_BYTE

config ZMK_KEYBOARD_NAME
    default "Byte"

endif
```

## config/boards/shields/kfa/Kconfig.shield
```kconfig
# Copyright (c) 2020 The ZMK Contributors
# SPDX-License-Identifier: MIT

config SHIELD_KFA
    def_bool $(shields_list_contains,kfa)
```

## config/boards/shields/mdk_test/Kconfig.defconfig
```kconfig
# Copyright (c) 2020 teoremma
# SPDX-License-Identifier: MIT

if SHIELD_MDK_TEST

config ZMK_KEYBOARD_NAME
	default "MDK Test"

endif
```

## config/boards/shields/mdk_test/Kconfig.shield
```kconfig
# Copyright (c) 2020 teoremma
# SPDX-License-Identifier: MIT

config SHIELD_MDK_TEST
	def_bool $(shields_list_contains,mdk_test)
```
